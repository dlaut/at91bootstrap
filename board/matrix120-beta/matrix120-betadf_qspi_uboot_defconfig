## board/matrix120-beta/matrix120-betadf_qspi_uboot_defconfig
```kconfig
CONFIG_MATRIX120_BETA=y
CONFIG_BUS_SPEED_166MHZ=y
CONFIG_RAM_128MB=y
CONFIG_DDRC=y
CONFIG_LPDDR1=y
CONFIG_DEBUG=y
CONFIG_IMG_ADDRESS="0x00030000"
CONFIG_IMG_SIZE="0x000D0000"
# CONFIG_ENTER_NWD is not set
CONFIG_QSPI=y
CONFIG_QSPI0_IOSET_2=y
CONFIG_DEBUG_VERY_LOUD=y
CONFIG_QSPI_4B_OPCODES=y
```

## board/matrix120-beta/matrix120-betadf_uboot_defconfig
```kconfig
CONFIG_MATRIX120_BETA=y
CONFIG_BUS_SPEED_166MHZ=y
CONFIG_RAM_128MB=y
CONFIG_DDRC=y
CONFIG_LPDDR1=y
CONFIG_DEBUG=y
CONFIG_IMG_ADDRESS="0x0000C000"
# CONFIG_ENTER_NWD is not set
```
